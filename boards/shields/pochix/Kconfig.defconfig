## boards/shields/pochix/Kconfig.defconfig
```kconfig
if SHIELD_POCHIX_RIGHT

config ZMK_KEYBOARD_NAME
    default "pochix"

endif

if SHIELD_POCHIX_LEFT || SHIELD_POCHIX_RIGHT

config ZMK_SPLIT
    default y

endif
```

## boards/shields/pochix/Kconfig.shield
```kconfig
config SHIELD_POCHIX_LEFT
    def_bool $(shields_list_contains,pochix_left)
config SHIELD_POCHIX_RIGHT
    def_bool $(shields_list_contains,pochix_right)
```

## config/west.yml
```yaml
manifest:
  remotes:
    - name: zmkfirmware
      url-base: https://github.com/zmkfirmware
    - name: sekigon-gonnoc
      url-base: https://github.com/sekigon-gonnoc
    - name: ITOKEN1005
      url-base: https://github.com/ITOKEN1005

  projects:
    # 順番を入れ替え、直接URLを指定して優先度を上げる
    - name: zmk-driver-iqs7211e
      url: https://github.com/ITOKEN1005/zmk-driver-iqs7211e
      revision: master 
    - name: zmk
      remote: zmkfirmware
      revision: v0.2
      import: app/west.yml
    - name: zmk-driver-paw3222
      remote: sekigon-gonnoc
      revision: main

  self:
    path: config
```
